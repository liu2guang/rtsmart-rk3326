## Kconfig
```kconfig
mainmenu "RT-Thread Project Configuration"

config BSP_DIR
    string
    option env="BSP_ROOT"
    default "."

config RTT_DIR
    string
    option env="RTT_ROOT"
    default "rt-thread"

config PKGS_DIR
    string
    option env="PKGS_ROOT"
    default "packages"

source "$RTT_DIR/Kconfig"
source "$PKGS_DIR/Kconfig"

config RK3326_SOC
    bool
    select ARCH_ARMV8
    select RT_USING_COMPONENTS_INIT
    select RT_USING_USER_MAIN
    select ARCH_CPU_64BIT
    default y

config RT_USING_GIC
    bool 
    default y

config RT_USING_CORETIMER
    bool 
    default y

source "driver/Kconfig"
```

## driver/Kconfig
```kconfig
menu "Hardware Drivers Config"
    menu "RK3326/PX30 Peripheral Drivers"
        menuconfig BSP_USING_UART
            bool "Enable UART"
            select RT_USING_SERIAL
            default y

            if BSP_USING_UART
                config BSP_USING_UART2
                bool "Enable UART2"
                default y
            endif
    endmenu

    menu "OGA2 Board Peripheral Drivers"
    endmenu
endmenu
```
